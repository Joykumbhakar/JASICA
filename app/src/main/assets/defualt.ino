/* ════════════════════════════════════════════════════════════════════════════
 * Smart Home Controller — Arduino UNO Code
 * Companion to the iOS-Design Android Kotlin App
 * * WIRING GUIDE:
 * ┌───────────────────────┬─────────────────────────┐
 * │ HC-05 Bluetooth       │ Arduino UNO             │
 * ├───────────────────────┼─────────────────────────┤
 * │ VCC                   │ 5V                      │
 * │ GND                   │ GND                     │
 * │ TXD                   │ RX (Pin 0)              │
 * │ RXD                   │ TX (Pin 1)              │
 * └───────────────────────┴─────────────────────────┘
 * * ┌───────────────────────┬─────────────────────────┐
 * │ Devices / Relays      │ Arduino UNO             │
 * ├───────────────────────┼─────────────────────────┤
 * │ Left Light            │ Pin 2                   │
 * │ Right Light           │ Pin 3                   │
 * │ Left Fan              │ Pin 4                   │
 * │ Right Fan             │ Pin 5                   │
 * └───────────────────────┴─────────────────────────┘
 * * ⚠️ CRITICAL UPLOAD INSTRUCTION ⚠️
 * Because you are using Pin 0 and Pin 1 for Bluetooth, you MUST unplug
 * the RX and TX wires from the Arduino before clicking "Upload" in the IDE.
 * Plug them back in after the upload is complete!
 * ════════════════════════════════════════════════════════════════════════════
 */

#include

// --- EEPROM ADDRESSES (For Power Outage Memory) ---
const int ADDR_LEFT_LIGHT  = 0;
const int ADDR_RIGHT_LIGHT = 1;
const int ADDR_LEFT_FAN    = 2;
const int ADDR_RIGHT_FAN   = 3;

// --- PIN DEFINITIONS ---
const int LEFT_LIGHT_PIN  = 2;
const int RIGHT_LIGHT_PIN = 3;
const int LEFT_FAN_PIN    = 4;
const int RIGHT_FAN_PIN   = 5;

// Built-in LED for visual feedback when a command is received
const int STATUS_LED      = 13;

// --- RELAY CONFIGURATION ---
// Most 4-channel relay modules are "Active-Low" (LOW turns them ON).
// If your devices turn ON when the app says OFF, change these two lines:
//   #define DEVICE_ON  LOW
//   #define DEVICE_OFF HIGH
#define DEVICE_ON  HIGH
#define DEVICE_OFF LOW

// Global string to hold incoming data (prevents memory fragmentation)
String command;

void setup() {
    // Initialize Serial Communication for HC-05 at standard 9600 baud rate
    Serial.begin(9600);

    // Reserve memory for the command string to optimize RAM usage
    command.reserve(50);

    // Configure device pins as outputs
    pinMode(LEFT_LIGHT_PIN, OUTPUT);
    pinMode(RIGHT_LIGHT_PIN, OUTPUT);
    pinMode(LEFT_FAN_PIN, OUTPUT);
    pinMode(RIGHT_FAN_PIN, OUTPUT);
    pinMode(STATUS_LED, OUTPUT);

    // Restore previous states from EEPROM (Power Outage Recovery)
    restoreDeviceState(LEFT_LIGHT_PIN, ADDR_LEFT_LIGHT);
    restoreDeviceState(RIGHT_LIGHT_PIN, ADDR_RIGHT_LIGHT);
    restoreDeviceState(LEFT_FAN_PIN, ADDR_LEFT_FAN);
    restoreDeviceState(RIGHT_FAN_PIN, ADDR_RIGHT_FAN);

    // Quick blink to show the Arduino has booted successfully
    digitalWrite(STATUS_LED, HIGH);
    delay(500);
    digitalWrite(STATUS_LED, LOW);
}

void loop() {
    // Check if data is available from the HC-05 module
    if (Serial.available() > 0) {

        // Read the incoming string until the newline character
        command = Serial.readStringUntil('\n');

        // Clean up the string (removes \r or accidental whitespace at the end)
        command.trim();

        // Process the command if it is not empty
        if (command.length() > 0) {
            // Flash the status LED to indicate data reception
            digitalWrite(STATUS_LED, HIGH);

            processCommand(command);

            delay(40); // Make the LED flash visible to the human eye
            digitalWrite(STATUS_LED, LOW);
        }
    }
}

/*
 * This function matches the exact strings generated by the Kotlin app's
 * toggle() function: send("turn  \n")
 */
void processCommand(String cmd) {
    bool commandRecognized = true;

    // --- LEFT LIGHT ---
    if (cmd == "turn on left light") {
        setDeviceState(LEFT_LIGHT_PIN, ADDR_LEFT_LIGHT, DEVICE_ON);
    }
    else if (cmd == "turn off left light") {
        setDeviceState(LEFT_LIGHT_PIN, ADDR_LEFT_LIGHT, DEVICE_OFF);
    }

        // --- RIGHT LIGHT ---
    else if (cmd == "turn on right light") {
        setDeviceState(RIGHT_LIGHT_PIN, ADDR_RIGHT_LIGHT, DEVICE_ON);
    }
    else if (cmd == "turn off right light") {
        setDeviceState(RIGHT_LIGHT_PIN, ADDR_RIGHT_LIGHT, DEVICE_OFF);
    }

        // --- LEFT FAN ---
    else if (cmd == "turn on left fan") {
        setDeviceState(LEFT_FAN_PIN, ADDR_LEFT_FAN, DEVICE_ON);
    }
    else if (cmd == "turn off left fan") {
        setDeviceState(LEFT_FAN_PIN, ADDR_LEFT_FAN, DEVICE_OFF);
    }

        // --- RIGHT FAN ---
    else if (cmd == "turn on right fan") {
        setDeviceState(RIGHT_FAN_PIN, ADDR_RIGHT_FAN, DEVICE_ON);
    }
    else if (cmd == "turn off right fan") {
        setDeviceState(RIGHT_FAN_PIN, ADDR_RIGHT_FAN, DEVICE_OFF);
    }
    else {
        commandRecognized = false;
    }

    // Send feedback over Bluetooth (Useful for debugging via Serial Monitor/BT Terminal)
    if (commandRecognized) {
        Serial.println("Executed: " + cmd);
    } else {
        Serial.println("Unknown Command: " + cmd);
    }
}

// --- EEPROM HELPER FUNCTIONS ---

void restoreDeviceState(int pin, int eepromAddr) {
    byte savedState = EEPROM.read(eepromAddr);

    // If EEPROM is blank/corrupt (usually 255 on a fresh board), default to OFF
    if (savedState != DEVICE_ON && savedState != DEVICE_OFF) {
        savedState = DEVICE_OFF;
        EEPROM.write(eepromAddr, savedState);
    }

    digitalWrite(pin, savedState);
}

void setDeviceState(int pin, int eepromAddr, byte state) {
    digitalWrite(pin, state);

    // .update() only writes to memory if the value has changed.
    // This protects the Arduino's EEPROM from wearing out!
    EEPROM.update(eepromAddr, state);
}